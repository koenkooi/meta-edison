## conf/machine/edison.conf
```bitbake
#@TYPE: Machine
#@NAME: edison

#@DESCRIPTION: Machine configuration for edison systems

include conf/machine/include/tune-atom.inc

MACHINE_FEATURES = "bluetooth alsa pci serial usbgadget usbhost wifi x86 ext3"
KERNEL_IMAGETYPE = "bzImage"
SERIAL_CONSOLES = "115200;ttyMFD2"
UBOOT_MACHINE = "edison_config"

PREFERRED_PROVIDER_virtual/kernel = "linux-edison"
PREFERRED_PROVIDER_virtual/bootloader = "u-boot-edison"

MACHINE_ESSENTIAL_EXTRA_RRECOMMENDS = "kernel-module-bcm4334x kernel-module-bcm-bt-lpm kernel-module-g-multi"

KERNEL_MODULE_PROBECONF = "g_multi bcm4334x"
KERNEL_MODULE_AUTOLOAD = "bcm_bt_lpm bcm4334x g_multi"

module_conf_bcm4334x = "options bcm4334x firmware_path=/etc/firmware/fw_bcmdhd.bin nvram_path=/etc/firmware/bcmdhd.cal"

# FIXME: file parameter should be based on partition UUID (from U-Boot) or fixed
# with label (label seems to work, but driver is probed too early)
module_conf_g_multi = "options g_multi file=/dev/mmcblk0p9 stall=0 idVendor=0x8087 idProduct=0x0A9E iProduct=Edison iManufacturer=Intel"
```

## conf/machine/include/image-fixups.inc
```bitbake
ROOTFS_POSTPROCESS_COMMAND += "edison_fixup_watchdog ; "

edison_fixup_watchdog() {
    ( cd ${IMAGE_ROOTFS}

    # Set WDT to 90s, otherwise it will hang ~68s after bootup
    if [ -e etc/systemd/system.conf ] ; then
        sed -i /RuntimeWatchdogSec/d etc/systemd/system.conf
        echo 'RuntimeWatchdogSec=90' >> etc/systemd/system.conf
    fi )
}
```
